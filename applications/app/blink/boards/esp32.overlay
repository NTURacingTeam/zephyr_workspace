/ {
    aliases {
        led0 = &built_in_led;
    };

    leds {
        compatible = "gpio-leds";
        built_in_led: led_0 {
            gpios = <&gpio0 2 GPIO_ACTIVE_HIGH>;
            label = "Built-in LED";
        };
    };
};