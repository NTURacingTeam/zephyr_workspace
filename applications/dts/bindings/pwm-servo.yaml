## applications/dts/bindings/pwm-servo.yaml
```yaml
description: PWM-driven servo motor.

compatible: "pwm-servo"

include: base.yaml

properties:
  pwms:
    required: true
    type: phandle-array
    description: |
      PWM spec for the servo motor.

  min-pulse:
    required: true
    type: int
    description: |
      Minimum pulse width (ns).

  neutral-pulse:
    required: false
    type: int
    description: |
      Neutral pulse width (ns), default to (min + max) / 2.

  max-pulse:
    required: true
    type: int
    description: |
      Maximum pulse width (ns).

  initial-duty:
    required: false
    type: int
    description: | 
      Initial duty (-100 ~ 100), if set, will be applied after the PWM is enabled.
```

## applications/dts/bindings/sensor/cui,amt21.yaml
```yaml
description: |
  CDI Devices AMT21 series absolute encoder.

compatible: "cui,amt21"

include: [sensor-device.yaml, uart-device.yaml]

properties:
  addr:
    type: int
    required: true
    description: Device address as specified in the datasheet.

  multi-turn:
    type: boolean
    description: |
      If the encoder is multi-turn, i.e. part number AMT21xC, D, G, or H.
```

## applications/dts/bindings/sensor/hall-rpm.yaml
```yaml
description: |
  General hall efect gear tooth senso.

compatible: "hall-rpm"

include: sensor-device.yaml

properties:
  gpios:
    type: phandle-array
    required: true
    description: |
      The GPIO pin connected to the sensor.
  num-tooth:
    type: int
    required: true
    description: |
      Number of tooth in the gear.
  sampling-freq:
    type: int
    default: 100
    description: |
      Sampling frequency in Hz.
  time-const:
    type: int
    default: 100
    description: |
      Time constant tau for exponetial average filter in millisecond. With
      sampling time interval T much smaller than time constant, the smoothing
      factor alpha is approximately equal to T/tau.
```

## applications/dts/bindings/sensor/res,zx.yaml
```yaml
description: |
  RES Instrument ZX series linear traveral sensor.

compatible: "res,zx"

include: sensor-device.yaml

properties:
  io-channels:
    type: phandle-array
    required: true
    description: |
      The ADC channel connected to the sensor.
  stroke:
    type: int
    required: true
    description: |
      Stroke of the sensor in mm.
```

## applications/dts/bindings/sensor/ssi,p51-curr.yaml
```yaml
description: |
  SSI Technologies P51 series pressure sensor with current output.

compatible: "ssi,p51-curr"

include: sensor-device.yaml

properties:
  io-channels:
    type: phandle-array
    required: true
    description: |
      The ADC channel connected to the sensor.
  full-scale:
    type: int
    required: true
    description: |
      Sensor pressure full scale in psi.
  shunt-resistor:
    type: int
    required: true
    description: |
      Value of the shunt resistor in milli-ohms.
  tolerance:
    type: int
    default: 5
    description: |
      Current value tolerance before it's considered out
      of valid range and in percentage.
```

## applications/dts/bindings/sensor/witmotion,jy901b.yaml
```yaml
description: |
  Wit Motion JY901B Ten-Axis Intertial Measurement Unit. See more info at
  https://wit-motion.yuque.com/wumwnr/docs/sozgn8

compatible: "witmotion,jy901b"

include: [sensor-device.yaml, i2c-device.yaml]
```

## applications/lib/nturt/Kconfig
```kconfig
config NTURT
	bool "Support for NTURT library"
	depends on CANOPENNODE
	help
	  This option enables NTU Racing Team common library

if NTURT

module = NTURT
module-str = NTURT
source "subsys/logging/Kconfig.template.log_config"

config NTURT_SYS_INIT_PRIORITY
	int "NTURT system module init priority"
	default 0
	help
	  NTURT common library system module initialization priority.

config NTURT_SENSORS_INIT_PRIORITY
	int "NTURT sensors module init priority"
	default 10
	help
	  NTURT common library sensors module initialization priority.

config NTURT_MSG_INIT_PRIORITY
	int "NTURT message module init priority"
	default 20
	help
	  NTURT common library message module initialization priority.

config NTURT_STATES_INIT_PRIORITY
	int "NTURT states module init priority"
	default 50
	help
	  NTURT common library states module init priority.

config NTURT_ERR_INIT_PRIORITY
	int "NTURT error module init priority"
	default 90
	help
	  NTURT common library error module initialization priority.

config NTURT_CTRL_THREAD_PRIORITY
	int "NTURT control module thread priority"
	default 1
	help
	  NTURT common library control module thread priority.

config NTURT_SENSORS_THREAD_PRIORITY
	int "NTURT sensors module thread priority"
	default 10
	help
	  NTURT common library sensors module thread priority.

config NTURT_DASH_THREAD_PRIORITY
	int "NTURT dashboard module thread priority"
	default 11
	help
	  NTURT common library dashboard module thread priority.

endif # NTURT
```

## applications/west.yml
```yaml
manifest:
  remotes:
    - name: zephyrproject-rtos
      url-base: https://github.com/zephyrproject-rtos
    - name: nturt
      url-base: https://github.com/NTURacingTeam

  group-filter: [+optional]

  projects:
    - name: zephyr
      remote: nturt
      revision: v4.0.0-nturt
      import: true
```
