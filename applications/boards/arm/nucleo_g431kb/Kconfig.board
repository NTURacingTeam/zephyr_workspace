## applications/boards/arm/nucleo_g431kb/Kconfig.board
```kconfig
# STM32G431KB Nucleo board configuration

config BOARD_NUCLEO_G431KB
	bool "Nucleo G431KB Development Board"
	depends on SOC_STM32G431XX
```

## applications/drivers/Kconfig
```kconfig
menu "Drivers"

rsource "auxdisplay/Kconfig"
rsource "gpio/Kconfig"
rsource "led_strip/Kconfig"
rsource "sensor/Kconfig"
rsource "servo/Kconfig"

endmenu
```

## applications/drivers/auxdisplay/Kconfig.gpio_seg_display
```kconfig
config AUXDISPLAY_GPIO_SEG_DISPLAY
    bool "Seven segment displays controlled by gpio as auxiliary display"
    default y
    depends on DT_HAS_GPIO_SEG_DISPLAY_ENABLED
    help
      Enable driver for seven segment displays controlled by gpio as auxiliary
      display
```

## applications/drivers/gpio/Kconfig.74hc595
```kconfig
config GPIO_74HC595
    bool "Diodes Incorporated 74HC595 shift register as GPIO extender"
    default y
    depends on DT_HAS_DIODES_74HC595_ENABLED
    depends on SPI
    help
      Enable driver for 74HC595 shift register as GPIO extender

if GPIO_74HC595

config GPIO_74HC595_INIT_PRIORITY
    int "Init priority"
    default 71
    help
      Device driver initialization priority.

endif
```

## applications/drivers/input/Kconfig.dashboard
```kconfig
config INPUT_DASHBOARD
    bool "NTU Racing dashboard button input keys"
    default y
    depends on DT_HAS_NTURT_DASHBOARD_ENABLED
    depends on CANOPENNODE
    help
      Enable driver for dashboard buttons

if INPUT_DASHBOARD

endif
```

## applications/drivers/led/Kconfig.dashboard
```kconfig
config INPUT_DASHBOARD
    bool "NTU Racing dashboard indicator LEDs"
    default y
    depends on DT_HAS_NTURT_DASHBOARD_ENABLED
    depends on CANOPENNODE
    help
      Enable driver for dashboard indicators

if INPUT_DASHBOARD

endif
```

## applications/drivers/led_strip/Kconfig.gpio
```kconfig
config LED_STRIP_GPIO
    bool "Array of LEDs controlled by GPIO as a single LED strip."
    default y
    depends on DT_HAS_GPIO_LED_STRIP_ENABLED
    help
      Enable driver for GPIO controlled LED strip
```

## applications/drivers/sensor/Kconfig
```kconfig
if SENSOR

rsource "amt21/Kconfig"
rsource "hall-rpm/Kconfig"
rsource "jy901b/Kconfig"
rsource "p51-curr/Kconfig"
rsource "zx/Kconfig"

endif # SENSOR
```

## applications/drivers/sensor/amt21/Kconfig
```kconfig
menuconfig AMT21
    bool "CUI Devices AMT21 series absolute encoders"
    default y
    depends on DT_HAS_CUI_AMT21_ENABLED
    help
      Enable driver for AMT21 series absolute encoder.

if AMT21

endif # AMT21
```

## applications/drivers/sensor/hall-rpm/Kconfig
```kconfig
menuconfig HALL_RPM
    bool "Hall-effect gear tooth speed sensor"
    default y
    depends on DT_HAS_HALL_RPM_ENABLED
    help
      Enable driver for hall-effect gear tooth speed sensor.

if HALL_RPM

endif # HALL_RPM
```

## applications/drivers/sensor/jy901b/Kconfig
```kconfig
menuconfig JY901B
    bool "Wit Motion JY901B Ten-Axis Intertial Measurement Unit"
    default y
    depends on DT_HAS_WITMOTION_JY901B_ENABLED
    select I2C
    help
      Enable driver for JY901B I2C-based ten-axis intertial measurement unit.

if JY901B

choice
  prompt "JY901B_ORIEN_MODE"
  default JY901B_ORIEN_ABSLOUTE
  help
    Specify the type of orientation angles/quaternions to be used by the driver.

config JY901B_ORIEN_ABSLOUTE
  bool "Absolute orientation using magnetometer"

config JY901B_ORIEN_RELATIVE
  bool "Relative orientation without magnetometer"

endchoice

endif # JY901B
```

## applications/drivers/sensor/p51-curr/Kconfig
```kconfig
menuconfig P51_CURR
    bool "SSI Technologies P51 series pressure sensor with current output"
    default y
    depends on DT_HAS_SSI_P51_CURR_ENABLED
    help
      Enable driver for P51 series pressure sensor.

if P51_CURR

endif # P51_CURR
```

## applications/drivers/sensor/zx/Kconfig
```kconfig
menuconfig ZX
    bool "RES Instrument ZX series linear traveral sensor"
    default y
    depends on DT_HAS_RES_ZX_ENABLED
    help
      Enable driver for ZX series linear traveral sensor.

if ZX

endif # ZX
```

## applications/drivers/servo/Kconfig
```kconfig
menuconfig SERVO
    bool "Servo Motor Drivers"
    help
      Enable config options for servo drivers.

if SERVO

module = SERVO
module-str = servo
source "subsys/logging/Kconfig.template.log_config"

config SERVO_INIT_PRIORITY
    int "Servo initialization priority"
    default KERNEL_INIT_PRIORITY_DEVICE
    help
      System initialization priority for servo drivers.

rsource "Kconfig.pwm"

endif # SERVO
```

## applications/drivers/servo/Kconfig.pwm
```kconfig
config SERVO_PWM
    bool "PWM-Driven Servo Driver"
	default y
	depends on DT_HAS_PWM_SERVO_ENABLED
    select PWM
    help
      This option enables PWM-driven servo driver.
```

## applications/dts/bindings/auxdisplay/gpio-seg-display.yaml
```yaml
description: |
  Seven segment displays that are controlled by GPIOs with decimal point
  support. Forms a multi-digit auxiliary display from multiple displays.

  Example configuration:

  auxdisplay_0: auxdisplay {
      compatible = "gpio-seg-display";
      #address-cells = <1>;
      #size-cells = <0>;
      decimal-point;
      columns = <2>;
      rows = <1>;
      status = "okay";

      seg-display@0 {
          reg = <0>;
          segment-gpios = <&gpioa 0 GPIO_ACTIVE_HIGH>,
                          <&gpioa 1 GPIO_ACTIVE_HIGH>,
                          <&gpioa 2 GPIO_ACTIVE_HIGH>,
                          <&gpioa 3 GPIO_ACTIVE_HIGH>,
                          <&gpioa 4 GPIO_ACTIVE_HIGH>,
                          <&gpioa 5 GPIO_ACTIVE_HIGH>,
                          <&gpioa 6 GPIO_ACTIVE_HIGH>,
                          <&gpioa 7 GPIO_ACTIVE_HIGH>;
      };

      seg-display@1 {
          reg = <1>;
          segment-gpios = <&gpiob 0 GPIO_ACTIVE_HIGH>,
                          <&gpiob 1 GPIO_ACTIVE_HIGH>,
                          <&gpiob 2 GPIO_ACTIVE_HIGH>,
                          <&gpiob 3 GPIO_ACTIVE_HIGH>,
                          <&gpiob 4 GPIO_ACTIVE_HIGH>,
                          <&gpiob 5 GPIO_ACTIVE_HIGH>,
                          <&gpiob 6 GPIO_ACTIVE_HIGH>,
                          <&gpiob 7 GPIO_ACTIVE_HIGH>;
      };
  };

compatible: gpio-seg-display

include: auxdisplay-device.yaml

properties:
  "#address-cells":
    required: true
    const: 1

  "#size-cells":
    required: true
    const: 0

  decimal-point:
    type: boolean
    description: |
      If present, the 7-segment display has a decimal point.

child-binding:
  description: |
    Each 7-segment display in the auxiliary display.

  properties:
    reg:
      type: array
      required: true
      description: |
        Index of the 7-segment display in the auxiliary display, the index
        increments from left to right, top to bottom.

    segment-gpios:
      type: phandle-array
      required: true
      description: |
        An array of GPIOs one per segment. The index of GPIOs correspond to
        segments according to the following diagram. Some displays also have a
        decimal point which can be specified as an optional segment with the
        index 7.

              0
              ---
            5|   |1
              -6-
            4|   |2
              ---  .
              3    7
```

## applications/dts/bindings/gpio/diodes,74hc595.yaml
```yaml
description: |
  74HC595 shift register as GPIO expander on SPI bus

  Supports multiple 74HC95 connected in series.

  Example configuration:

  &spi0 {
      ...

      74hc595@0 {
          compatible = "diodes,74hc595";
          #address-cells = <1>;
          #size-cells = <0>;
          reg = <0>;
          spi-max-frequency = <25000000>;

          ex-gpio0@0 {
              reg = <0>;
              gpio-controller;
              ngpios = <8>;
              #gpio-cells = <2>;
          };

          ex-gpio1@1 {
              reg = <1>;
              gpio-controller;
              ngpios = <8>;
              #gpio-cells = <2>;
          };
      };
  };

compatible: "diodes,74hc595"

include: spi-device.yaml

properties:
  "#address-cells":
    required: true
    const: 1

  "#size-cells":
    required: true
    const: 0

child-binding:
  description: |
    Each 74HC595 chips connected in series

  include: gpio-controller.yaml

  properties:
    reg:
      type: array
      required: true
      description: Index of the 74HC595 chip in the series

    ngpios:
      type: int
      required: true
      const: 8
      description: Number of supported gpios

    "#gpio-cells":
      const: 2

  gpio-cells:
    - pin
    - flags
```

## applications/dts/bindings/input/nturt,dash-keys.yaml
```yaml
description: NTU Racing Team dashboard buttons

compatible: "nturt,dash-keys"

properties:
  index:
    required: true
    type: int
    description: |
      CANopen object dictionary entry index of the buttons.
  zephyr,code:
    required: true
    type: array
    description: |
      Key code to emit for each button.
```

## applications/dts/bindings/led/nturt,dash-leds.yaml
```yaml
description: NTU Racing Team dashboard LEDs

compatible: "nturt,dash-leds"

properties:
  index:
    required: true
    type: int
    description: |
      CANopen object dictionary entry index of the LEDs.
  node-id:
    required: true
    type: int
    description: |
      CANopen node ID of the dashboard.
```

## applications/dts/bindings/led_strip/gpio-led-strip.yaml
```yaml
description: |
  Array of LEDs controlled by GPIO as a single LED strip.

compatible: gpio-led-strip

include: led-strip.yaml

properties:
  red-gpios:
    type: phandle-array
    description: GPIO pins for red channel.

  green-gpios:
    type: phandle-array
    description: GPIO pins for green channel.

  blue-gpios:
    type: phandle-array
    description: GPIO pins for blue channel.
```
